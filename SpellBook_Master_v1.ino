#include <Adafruit_SharpMem.h>

#include <ArduinoJson.h>
#include "Spell.h"
#include <Wire.h>
#include <Adafruit_GFX.h>
#include <RotaryEncoder.h>
#include "Adafruit_LEDBackpack.h"
#include <Fonts/FreeSansBold12pt7b.h>
#include <Fonts/FreeSansBold9pt7b.h>
#include <Fonts/FreeSans9pt7b.h>
#include <SPI.h>
#include <SD.h>
#include <StreamUtils.h>


#define ENCODER_BUTT 6 //sw
#define ENCODER_1 5 //clk
#define ENCODER_2 9 //dt

#define SHARP_SCK  13
#define SHARP_MOSI 12
#define SHARP_SS   11

#define BLACK 0
#define WHITE 1

#define SILVER_BUTT A0

const int SPELLCOUNT = 21;
const PROGMEM char* fileNames[SPELLCOUNT] = {"0MENDING.TXT","0SACRE~1.TXT","0SPRDYIN.TXT","0THAUMAT.TXT","0TOLLDED.TXT","1DETGOOD.TXT","1DETMAGC.TXT","1DETPOSN.TXT","1GUDBOLT.TXT","1HEALWRD.TXT","1INFWOUN.TXT","1PROEVIL.TXT","1PURFOOD.TXT","1SANCTUR.TXT","1SHLDFTH.TXT","1BANE000.TXT","1BLESS000.TXT","1CEREMNY.TXT","1COMMA~1.TXT","1CRTWATR.TXT","1CUREWND.TXT"}; 

const unsigned char habbakukRelic [] PROGMEM = {
  // 'Reliquarry Picture 2, 400x240px
  0xff, 0xff, 0xff, 0xff, 0xff, 0xff, 0xff, 0xff, 0xff, 0xff, 0xff, 0xff, 0xff, 0xff, 0xff, 0xff, 
  0xff, 0xff, 0xff, 0xff, 0xff, 0xff, 0xff, 0xff, 0xff, 0xff, 0xff, 0xff, 0xff, 0xff, 0xff, 0xff, 
  0xff, 0xff, 0xff, 0xff, 0xff, 0xff, 0xff, 0xff, 0xff, 0xff, 0xff, 0xff, 0xff, 0xff, 0xff, 0xff, 
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  0xff, 0xff, 0xff, 0xff, 0xff, 0xff, 0xff, 0xff, 0xff, 0xff, 0xff, 0xff, 0xff, 0xff, 0xff, 0xff
};


Adafruit_8x8matrix matrix = Adafruit_8x8matrix();
RotaryEncoder encoder(ENCODER_1, ENCODER_2);
Adafruit_SharpMem display(SHARP_SCK, SHARP_MOSI, SHARP_SS, 400, 240);

Spell* spell;

uint8_t activeSlot = 0;
int activeSpell = 0;
const uint8_t SPELL_LEVELS = 4;
uint8_t slotsMax[SPELL_LEVELS] = {4,3,3,3};
uint8_t slotsLeft[SPELL_LEVELS] = {4,3,3,3};

uint8_t currentPage = 0;

enum class knobMode : uint8_t
{
  Spells, Slots
};
knobMode knob = knobMode::Spells;


void setup() {
  Serial.begin(9600);
  //while (!Serial) {
  //  ; // wait for serial port to connect. Needed for native USB port only
  // }
  
  pinMode(ENCODER_BUTT, INPUT_PULLUP);
  pinMode(SILVER_BUTT, INPUT_PULLUP);
  matrix.begin(0x70);  // pass in the address
  matrix.setRotation(0);
  matrix.setBrightness(5);
  matrix.clear();
  matrix.writeDisplay();
  
  display.begin();
  display.clearDisplay();
  display.setRotation(2);
  display.drawBitmap(0,0,habbakukRelic,400,240,BLACK);
  display.refresh();
  delay(3000);
  display.clearDisplay();
  SD.begin(4);
  
  parseSpellJson(activeSpell);
  draw_slots(true);
  drawSpells();
}

void loop() {
  //Serial.println(tome[0]->range);
  //check encoder
  static int pos = 0;
  encoder.tick();
  int newPos = encoder.getPosition();
  if (pos != newPos){
    if(knob == knobMode::Slots) slotEncoderUpdate(pos,newPos);
    else if(knob == knobMode::Spells) spellEncoderUpdate(pos,newPos);
    Serial.println(newPos);  
    pos=newPos;
  }
  
  if(knob == knobMode::Slots) draw_slots(true);
  else if(knob == knobMode::Spells) draw_slots(false);


  if (digitalRead(ENCODER_BUTT) == LOW) {
    if(knob == knobMode::Slots) knob = knobMode::Spells;
    else if(knob == knobMode::Spells) knob = knobMode::Slots;
    delay(300);
  }

  if (digitalRead(SILVER_BUTT) == LOW) {
    currentPage ++;
    if (currentPage > 3) currentPage = 0;
    drawSpells();
  }
}

//////////////////////////////////////////////

void parseSpellJson(int spellNum) {
  
  
  File spellJSON = SD.open(fileNames[spellNum]);
  const size_t capacity = JSON_OBJECT_SIZE(12) + 1240;
  DynamicJsonDocument doc(capacity);
  deserializeJson(doc,spellJSON);
  delete spell;
  spell = new Spell(doc["name"], doc["casting_time"], doc["components"], doc["duration"], doc["level"], doc["range"], doc["ritual"], doc["school"], doc["page1"], doc["page2"], doc["page3"], doc["page4"]);
}

void draw_slots(bool showCursor) {
  matrix.clear();
  for (uint8_t lvl = 0; lvl < SPELL_LEVELS; lvl++) {
     for (uint8_t left = 0; left < slotsLeft[lvl]; left++) {
       matrix.drawPixel(2+left, lvl, LED_ON); 
     }
  }
  if (showCursor) matrix.drawPixel(0,activeSlot, LED_ON);
  matrix.writeDisplay();
}

void slotEncoderUpdate(int pos, int newPos) {
  if (pos > newPos) {
    activeSlot++;
    if (activeSlot >= SPELL_LEVELS) activeSlot = 0; 
  }
  else if (pos < newPos) {
    slotsLeft[activeSlot]--;
    if (slotsLeft[activeSlot] > 10) slotsLeft[activeSlot] = slotsMax[activeSlot];
  }
}


void spellEncoderUpdate(int pos, int newPos) {
  if (pos > newPos) {
    activeSpell++;
    if (activeSpell > SPELLCOUNT-1) activeSpell = 0; 
  }
  else if (pos < newPos) {
    activeSpell--;
    if (activeSpell < 0) activeSpell = SPELLCOUNT-1;
  }
  parseSpellJson(activeSpell);
  currentPage = 0;
  drawSpells();
}

void drawSpells(){
  display.clearDisplay();
  display.setTextColor(BLACK);
  
  display.setFont(&FreeSansBold12pt7b);
  display.setCursor(0,18);
  display.print(spell->level);
  display.print("  -  ");
  display.print(spell->spellName);
  if(spell->ritual) display.println("     RITUAL");
  else display.println("");

  display.setFont(&FreeSansBold9pt7b);
  display.setTextWrap(false);
  display.setCursor(0,36);
  display.print("Cast time: ");
  display.print(spell->casting_time);
  display.setCursor(200,36);
  display.print("Range: ");
  display.println(spell->range);
  display.setCursor(0,52);
  display.print("Components: ");
  display.print(spell->components);
  display.setCursor(200,52);
  display.print("Duration: ");
  display.println(spell->duration);

  display.setCursor(0,80);
  display.setFont(&FreeSans9pt7b);
  display.setTextColor(BLACK);
  if (currentPage == 0) display.println(spell->page0);
  else if (currentPage == 1) display.println(spell->page1);
  else if (currentPage == 2) display.println(spell->page2);
  else if (currentPage == 3) display.println(spell->page3);

  display.refresh();
  delay(300);
}
